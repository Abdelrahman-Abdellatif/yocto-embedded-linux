## meta-abou-infotainment/meta-audio-distro/conf/distro/include/sysvinit.inc
```bitbake
# Select sysvinit as init manager
VIRTUAL-RUNTIME_init_manager = "sysvinit"
VIRTUAL-RUNTIME_initscripts = "initscripts"
```
