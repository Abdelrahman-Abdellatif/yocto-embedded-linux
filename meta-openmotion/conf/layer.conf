## meta-openmotion/conf/layer.conf
```bitbake
# We have a conf and classes directory, add to BBPATH
BBPATH .= ":${LAYERDIR}"

# We have recipes-* directories, add to BBFILES
BBFILES += "${LAYERDIR}/recipes-*/*/*.bb \
            ${LAYERDIR}/recipes-*/*/*.bbappend"

BBFILE_COLLECTIONS += "openmotion"
BBFILE_PATTERN_openmotion = "^${LAYERDIR}/"
BBFILE_PRIORITY_openmotion = "6"

LAYERDEPENDS_openmotion = "core"
LAYERSERIES_COMPAT_openmotion = "scarthgap"
```

## meta-student/conf/layer.conf
```bitbake
# We have a conf and classes directory, add to BBPATH
BBPATH .= ":${LAYERDIR}"

# We have recipes-* directories, add to BBFILES
BBFILES += "${LAYERDIR}/recipes-*/*/*.bb \
            ${LAYERDIR}/recipes-*/*/*.bbappend"

BBFILE_COLLECTIONS += "meta-student"
BBFILE_PATTERN_meta-student = "^${LAYERDIR}/"
BBFILE_PRIORITY_meta-student = "6"

LAYERDEPENDS_meta-student = "core"
LAYERSERIES_COMPAT_meta-student = "scarthgap"
```
